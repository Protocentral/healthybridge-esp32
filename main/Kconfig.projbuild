## main/Kconfig.projbuild
```kconfig
menu "HealthyBridge"

choice HB_PROFILE
    prompt "Host product profile"
    default HB_PROFILE_HP5
    help
      Selects the payload schema for the type IDs that differ per product
      (0x20 biosignal, 0x40 vitals). The hb_link dispatch decodes the matching
      HP5 or HP6 struct and adapts it into the shared consumer path.

config HB_PROFILE_HP5
    bool "HealthyPi 5 (16-byte combined biosig sample)"

config HB_PROFILE_HP6
    bool "HealthyPi 6 (32-byte multi-channel sample)"

endchoice

config HB_UART_BAUD_HP6
    int "HealthyPi 6 host-link baud"
    depends on HB_PROFILE_HP6
    default 921600
    help
      Baud for the HealthyPi 6 UART link. Must match the M7's UART4.

      HealthyPi 5's rate is fixed at 921600 by the frozen wire contract
      (HB_UART_BAUD in healthybridge.h) and is not configurable here.

      Bring a board up at 921600 first — it is bit-identical to the released
      HealthyPi 5 configuration, so a failure there is unambiguously an HP6
      problem. 2000000 is the intended steady state: it divides exactly on both
      ends (C6 PLL_F80M 80 MHz / 40; STM32 PCLK1 100 MHz / 50), so there is no
      baud error, and the offered load is only ~19 kB/s either way.

config HB_RADIOS_OFF_AT_BOOT
    bool "Start with both radios down; wait for the host to enable them"
    default y if HB_PROFILE_HP6
    default n
    help
      Bring the Wi-Fi and BLE stacks up at boot but start NEITHER radio, until
      the host MCU asks via HB_CMD_WIFI_ENABLE / HB_CMD_WIFI_SOFTAP /
      HB_CMD_BLE_ADV_START.

      Default behaviour without this is that app_main() starts both radios
      unconditionally: NimBLE advertises forever, and Wi-Fi either connects STA
      or -- on a unit with no stored credentials, i.e. every factory-fresh one --
      opens a SoftAP captive portal that is sticky and therefore never times out.
      On HealthyPi 6 that happens ~220 ms into the M7's bring-up, concurrent with
      SDRAM, backlight, sensor init and USB enumeration. A unit powered only from
      USB browns out and resets: the BQ24074's input ceiling is strapped in
      hardware, so drawing less is the only lever firmware has.

      Note what is still initialised: esp_netif, the default event loop,
      esp_wifi_init() and the NimBLE host. Only esp_wifi_start() (which powers
      the PHY and runs calibration -- the actual current spike) and
      ble_gap_adv_start() are withheld. GET_STATUS answers correctly throughout,
      and mqtt/dashboard/OpenView keep the event loop and netif they depend on.

      Default n for HealthyPi 5, whose host may never send an enable command and
      whose shipped behaviour is frozen.

comment "HP6-only consumers (BLE / Wi-Fi / dashboard / MQTT stay shared)"

config HB_ENABLE_OPENVIEW
    bool "OpenView TCP streaming"
    default y if HB_PROFILE_HP6
    default n
    help
      HealthyPi 6 OpenView desktop streaming: 50-byte binary waveform packets
      broadcast over raw TCP on port 5000. Gates openview_protocol.c and
      wifi_server.c. Not used by HealthyPi 5.

      There is no WebSocket consumer — the local dashboard serves waveforms
      over SSE from its own HTTP server, and the legacy HP6 websocket_stream
      module was dropped rather than ported.

config HB_ENABLE_SMP_GATEWAY
    bool "MCUmgr SMP gateway"
    default y if HB_PROFILE_HP6
    default n
    help
      Bridge MCUmgr SMP (firmware update / stat / fs) between a BLE/Wi-Fi client
      and the HealthyPi 6 host MCU. Gates the smp_gateway / smp_client consumers.
      Not used by HealthyPi 5.

endmenu
```
